## components/espnow_server/Kconfig.projbuild
```kconfig
menu "ESPNOW Server options"
    config ESPNOW_MAX_SEND_ATTEMPTS
        int "Number of ESPNOW send attempts"
        default 5
        help
            The number of retries when sending an
            ESPNOW message

    config ESPNOW_SEND_DELAY
        int "Delay between ESPNOW send attempts"
        default 0
        help
            The amount of artifical delay between sending
            ESPNOW messages 

    config ESPNOW_CHANNEL
        int "Channel"
        default 1
        range 0 14
        help
            The channel on which sending and receiving ESPNOW data.

    config ESPNOW_DEFAULT_UID_ENABLE
        bool "Use default UID when NVS is empty"
        default n
        help
            NVS に保存済みアドレスがない場合に下記 UID を使用する。
            RotorHazard が MSP_ELRS_SET_SEND_UID を送信しない場合の回避策。

    if ESPNOW_DEFAULT_UID_ENABLE
        config ESPNOW_DEFAULT_UID_B0
            int "UID Byte 0"
            default 0
            range 0 255
        config ESPNOW_DEFAULT_UID_B1
            int "UID Byte 1"
            default 0
            range 0 255
        config ESPNOW_DEFAULT_UID_B2
            int "UID Byte 2"
            default 0
            range 0 255
        config ESPNOW_DEFAULT_UID_B3
            int "UID Byte 3"
            default 0
            range 0 255
        config ESPNOW_DEFAULT_UID_B4
            int "UID Byte 4"
            default 0
            range 0 255
        config ESPNOW_DEFAULT_UID_B5
            int "UID Byte 5"
            default 0
            range 0 255
    endif
endmenu
```

## components/tcp_server/Kconfig.projbuild
```kconfig
menu "TCP Socket Server options"
    config TCP_SERVER_PORT
        int "TCP server listening port"
        default 8080
        help
            Set TCP server listening port.

    choice TCP_CONNECTION_TYPE
        prompt "Network connection type"
        default TCP_USE_ETHERNET
        help
            Select the network interface for the TCP server.
            - Ethernet: Waveshare ESP32-S3 Ethernet board (W5500)
            - WiFi:     XIAO ESP32-S3 or any WiFi-only ESP32-S3 board

        config TCP_USE_ETHERNET
            bool "Ethernet (W5500 / Waveshare ESP32-S3)"

        config TCP_USE_WIFI
            bool "WiFi Station (XIAO ESP32-S3 etc.)"
    endchoice

    if TCP_USE_WIFI
        config TCP_WIFI_SSID
            string "WiFi SSID"
            default "myssid"
            help
                SSID of the WiFi access point to connect to.

        config TCP_WIFI_PASSWORD
            string "WiFi Password"
            default ""
            help
                Password for the WiFi access point.
    endif

endmenu
```

## main/Kconfig.projbuild
```kconfig
menu "XIAO ESP32-S3 options"

    config XIAO_EXTERNAL_ANTENNA
        bool "Enable external U.FL antenna (XIAO ESP32-S3 Sense, GPIO14)"
        default n
        help
            Drive GPIO14 HIGH to route RF through the external U.FL connector
            instead of the built-in PCB antenna.
            Only needed on the XIAO ESP32-S3 Sense variant when an external
            antenna is physically attached.

endmenu
```

## sdkconfig.defaults
```kconfig
# sdkconfig.defaults - XIAO ESP32-S3 (WiFi STA) default configuration

# --- Target ---
CONFIG_IDF_TARGET="esp32s3"

# --- Connection type: WiFi ---
CONFIG_TCP_USE_WIFI=y

# --- WiFi credentials ---
CONFIG_TCP_WIFI_SSID="y_air-GL"
CONFIG_TCP_WIFI_PASSWORD="88888888"

# --- External antenna (Sense variant only) ---
# CONFIG_XIAO_EXTERNAL_ANTENNA=y

# --- TCP server port ---
CONFIG_TCP_SERVER_PORT=8080

# --- ESP-NOW (channel fixed value for Ethernet mode) ---
CONFIG_ESPNOW_CHANNEL=1
CONFIG_ESPNOW_MAX_SEND_ATTEMPTS=5
CONFIG_ESPNOW_SEND_DELAY=0

# --- Flash size (XIAO ESP32-S3 = 8MB) ---
CONFIG_ESPTOOLPY_FLASHSIZE_8MB=y
CONFIG_ESPTOOLPY_FLASHSIZE="8MB"

# --- FreeRTOS tick rate ---
CONFIG_FREERTOS_HZ=1000
```
